## config/boards/shields/chimera/Kconfig.defconfig
```kconfig
if chimera_left

config ZMK_KEYBOARD_NAME
    default "Chimera"

config ZMK_SPLIT_ROLE_CENTRAL
    default y

endif

if chimera_left || chimera_right

config ZMK_SPLIT
    default y

endif
```

## config/boards/shields/chimera/Kconfig.shield
```kconfig
config chimera_left
    def_bool $(shields_list_contains,chimera_left)
config chimera_right
    def_bool $(shields_list_contains,chimera_right)
```

## config/boards/shields/chimera/chimera_left_defconfig
```kconfig
CONFIG_ZMK_DISPLAY=y
CONFIG_ZMK_WIDGET_LAYER_STATUS=y
CONFIG_ZMK_WIDGET_BATTERY_STATUS=y
CONFIG_ZMK_WIDGET_BATTERY_STATUS_SHOW_PERCENTAGE=y
CONFIG_ZMK_WIDGET_OUTPUT_STATUS=y
CONFIG_ZMK_WIDGET_WPM_STATUS=y
CONFIG_PINCTRL=y

//MAYBE GO BACK TO
//If CONFIG_ZMK_DISPLAY is enabled, exactly zero or one of the following options must be set to y. The first option is used if none are set.
//CONFIG_ZMK_DISPLAY_STATUS_SCREEN_BUILT_IN //Use the built-in status screen
//CONFIG_ZMK_DISPLAY_STATUS_SCREEN_CUSTOM //Use a custom status screen

CONFIG_ZMK_WIDGET_WPM_STATUS=n
CONFIG_ZMK_SLEEP=n
#CONFIG_LVGL_USE_THEME_MONO=n
```

## config/boards/shields/sofleEgg/Kconfig.defconfig
```kconfig
if SHIELD_SOFLEEGG_LEFT

config ZMK_KEYBOARD_NAME
    default "SofleEgg"

config ZMK_SPLIT_ROLE_CENTRAL
    default y

endif

if SHIELD_SOFLEEGG_LEFT || SHIELD_SOFLEEGG_RIGHT

config ZMK_SPLIT
    default y

endif
```

## config/boards/shields/sofleEgg/Kconfig.shield
```kconfig
config SHIELD_SOFLEEGG_LEFT
    def_bool $(shields_list_contains,SofleEgg_left)

config SHIELD_SOFLEEGG_RIGHT
    def_bool $(shields_list_contains,SofleEgg_right)
```

## config/boards/shields/yarisugi/Kconfig.shield
```kconfig
config yarisugi_left
    def_bool $(shields_list_contains,yarisugi_left)
config yarisugi_right
    def_bool $(shields_list_contains,yarisugi_right)
```

## config/west.yml
```yaml
manifest:
  remotes:
    # - name: zmkfirmware
    #   url-base: https://github.com/zmkfirmware
    - name: petejohanson
      url-base: https://github.com/petejohanson
    - name: akscram
      url-base: https://github.com/akscram
    # Additional modules containing boards/shields/custom code can be listed here as well
    # See https://docs.zephyrproject.org/3.2.0/develop/west/manifest.html#projects
  projects:
    # - name: zmk
    #   remote: zmkfirmware
    #   revision: main
    #   import: app/west.yml
    #   import: app/west.yml
    # - name: cirque-input-module
    #   remote: petejohanson
    #   revision: main
    - name: zephyr
      remote: akscram
      revision: driver-input-pinnacle
      import: app/west.yml
    - name: zmk
      remote: petejohanson
      revision: feat/pointers-move-scroll

  self:
    path: config
```
